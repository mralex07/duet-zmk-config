## config/west.yml
```yaml
manifest:
  remotes:
    - name: zmk
      url-base: https://github.com/urob
    - name: petejohanson
      url-base: https://github.com/petejohanson
  projects:
    - name: zmk
      remote: urob
      revision: main
      import: app/west.yml 
    - name: zmk
      remote: petejohanson
      revision: studio/keymap-subsystem
  self:
    path: config
```
